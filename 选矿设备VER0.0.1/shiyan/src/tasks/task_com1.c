/******************************************************************************
Copyright 2005 大连金德姆电子有限公司
All rights riserved.

文件名	：task_com0.c
模块名称：COM0通讯任务程序
功能概要：COM0通讯任务程序

取代版本：0.0.1
修改人	：许岩
完成日期：2005.04.06
升级说明：create

******************************************************************************/
#include 		"config.h"


extern volatile DEV_STAT DevStat;
extern INT8U Com1SndBuf[];				//串口发送缓冲区
//extern INT8U Com1RcvBuf[];              //串口接收缓冲区

INT16U Com1ModbusRcvlen = 0;					//串口0接收长度

/******************************************************************************
 函数名称：Task_Com1
 功能描述：COM1通讯任务
 参数描述：
 参数名称： 输入/输出？ 类型		描述
				
 返  回  值：无
				   
 作 	 者 ：许岩
 日 	 期：2005-04-11
 修改历史：
		日期		修改人		修改描述
		------		---------	-------------
******************************************************************************/
void Task_Com1(void * data)
{


	ToggleWD();

	data = data;

//  UART1_Init(9600);
	UART1_Init(19200);

	for ( ;; )		   //连接
	{
		ToggleWD();

//      OSTimeDlyHMSM(0, 0, 0, 200);            //200ms一次
		OSTimeDlyHMSM(0, 0, 0, 400);			//400ms一次

		com1_send_hex_daxian(Com1SndBuf, strlen(Com1SndBuf));

	}
}

///******************************************************************************
// 函数名称：com1_send_hex_modbus
// 功能描述：封装协议包尾,发送出去
// 参数描述：
// 参数名称： 输入/输出？ 类型        描述
// str_to_send    输入    INT8U *     要发送的字符串
// len                输入        INT16U      发送长度
//
// 返  回  值：无
//
// 作      者 ：许岩
// 日      期：2005-04-07
// 修改历史：
//        日期        修改人      修改描述
//        ------      ---------   -------------
//******************************************************************************/
//void com1_send_hex_modbus(INT8U * str_to_send, INT16U len)
//{
//    (void)Mb_calcul_crc(str_to_send, len);
//    com1_send_hex(str_to_send, len + 2);
//}
//
///******************************************************************************
// 函数名称：com1_snd_and_rcv
// 功能描述：发送并接收
// 参数描述：
// 参数名称： 输入/输出？ 类型        描述
// str_to_send    输入    INT8U *     要发送的字符串
// len            输入    INT16U      发送长度
// str_rcvd       输出    INT8U *     接收到的字符串
// rcv_len        输出    INT16U *    接收长度
//
// 返  回  值：ok-接收成功
//            notok-接收失败
//
// 作      者 ：许岩
// 日      期：2005-04-07
// 修改历史：
//        日期        修改人      修改描述
//        ------      ---------   -------------
//******************************************************************************/
//INT8U com1_snd_and_rcv(INT8U * str_to_send, INT16U len, INT8U *str_rcvd, INT16U* rcv_len)
//{
//    INT8U i = 0;
//    INT8U j = 0;
//
//    ToggleWD();
//
//
//    for ( i=0; i<COM1_RETRY_TIMES; i++ )
//    {
//        CleanCom1Buf();
//
//        com1_send_hex_modbus((void *)str_to_send, len);
//        j = com1_gets((void *)str_rcvd, rcv_len, 200, 20);          //等待接收一包数据
//        if ( j == ok )
//        {
//            if ( (str_rcvd[0] != 0x12) && (str_rcvd[0] != 0) )            //不是发给此终端的命令
//            {
//                continue;
//            }
//
//            if ( Mb_test_crc(str_rcvd, *rcv_len - 2) != ok )      // 校验CRC
//            {
//                continue;
//            }
//            break;
//        }
//        else if ( j == KEY_CANCEL )
//        {
//            //@@@
//        }
//    }
//    if ( i >= COM1_RETRY_TIMES )
//    {
//        return notok;
//    }
//    return ok;
//}

///******************************************************************************
// 函数名称：xray_ad_to_v
// 功能描述：X射线源控制器的AD值，转化为电压值(350表示35kV)
// 参数描述：
// 参数名称： 输入/输出？ 类型        描述
// ad         输入        INT16U      X射线源控制器的AD值
//
// 返  回  值：电压值(350表示35kV)
//
// 作      者 ：许岩
// 日      期：2005-04-07
// 修改历史：
//        日期        修改人      修改描述
//        ------      ---------   -------------
//******************************************************************************/
//INT16U xray_ad_to_v(INT16U ad)
//{
//    ToggleWD();
//
////   v     ad
////  --- = ---
////   80   4095
//    return (INT16U)(((FP64)ad * 800.0) / 4095.0);   //X射线电压实际值
//}
//
///******************************************************************************
// 函数名称：xray_v_to_ad
// 功能描述：电压值(350表示35kV)，转化为X射线源控制器的AD值
// 参数描述：
// 参数名称： 输入/输出？ 类型        描述
// v          输入        INT16U      电压值(350表示35kV)
//
// 返  回  值：X射线源控制器的AD值
//
// 作      者 ：许岩
// 日      期：2005-04-07
// 修改历史：
//        日期        修改人      修改描述
//        ------      ---------   -------------
//******************************************************************************/
//INT16U xray_v_to_ad(INT16U v)
//{
//    ToggleWD();
//
//    return (INT16U)(((FP64)v * 4095.0) / 800.0);
//}
//
///******************************************************************************
// 函数名称：xray_ad_to_i
// 功能描述：X射线源控制器的AD值，转化为电流值(100表示10uA)
// 参数描述：
// 参数名称： 输入/输出？ 类型        描述
// ad         输入        INT16U      X射线源控制器的AD值
//
// 返  回  值：电压值(350表示35kV)
//
// 作      者 ：许岩
// 日      期：2005-04-07
// 修改历史：
//        日期        修改人      修改描述
//        ------      ---------   -------------
//******************************************************************************/
//INT16U xray_ad_to_i(INT16U ad)
//{
//    ToggleWD();
//
////   i     ad
////  --- = ---
////  250   4095
//    return (INT16U)(((FP64)ad * 2500.0) / 4095.0);  //X射线电流实际值
//}
//
///******************************************************************************
// 函数名称：xray_i_to_ad
// 功能描述：电流值(100表示10uA)，转化为X射线源控制器的AD值
// 参数描述：
// 参数名称： 输入/输出？ 类型        描述
// i          输入        INT16U      电流值(100表示10uA)
//
// 返  回  值：X射线源控制器的AD值
//
// 作      者 ：许岩
// 日      期：2005-04-07
// 修改历史：
//        日期        修改人      修改描述
//        ------      ---------   -------------
//******************************************************************************/
//INT16U xray_i_to_ad(INT16U i)
//{
//    ToggleWD();
//
//    return (INT16U)(((FP64)i * 4095.0) / 2500.0);
//}

/******************************************************************************
 函数名称：decode_slv
 功能描述：把ascii代码转换为用于显示的字符，副显
 参数名称：	输入/输出？	类型		描述
 ascii			输入			INT8S		要显示的ascii代码
 
 返  回  值：解码后的结果
 
 作      者	：许岩
 日      期：2006-03-22
 修改历史：
		日期		修改人		修改描述
		------		---------	-------------
******************************************************************************/
INT8U decode_slv(INT8S ascii)
{
	ToggleWD();

	switch ( ascii )
	{
		
		case ' ':
			return 30;
			break;

		case '-':
			return 32;
			break;


		case '0':
		case '1':
		case '2':
		case '3':
		case '4':
		case '5':
		case '6':
		case '7':
		case '8':
		case '9':
			return(ascii - '0');
			break;

		default:
			return 30;
			break;
	}
}

/******************************************************************************
 函数名称：com1_send_hex_daxian
 功能描述：向大显输出
 参数描述：
 参数名称： 输入/输出？ 类型		描述
 str_to_send	输入	INT8U *		要发送的字符串
 len				输入	INT16U		长度
				
 返  回  值：无
				   
 作 	 者 ：许岩
 日 	 期：2005-04-07
 修改历史：
		日期		修改人		修改描述
		------		---------	-------------
******************************************************************************/
void com1_send_hex_daxian(INT8U * str_to_send, INT16U len)
{
	INT16U i = 0;

	ToggleWD();

	for ( i=1; i<len; i++ )
	{
		ToggleWD();
		SleepMs(1);
		UART1Putch(str_to_send[i]);
	}

}

/******************************************************************************
 函数名称：display_slv
 功能描述：显示显存中的数据到屏幕上，副显
 参数名称：	输入/输出？	类型		描述
 str		输入		INT8U *		要显示的字符串
 
 返  回  值：无
 
 作      者	：许岩
 日      期：2006-03-22
 修改历史：
		日期		修改人		修改描述
		------		---------	-------------
******************************************************************************/
void display_slv(INT8U *str)
{
	ToggleWD();

	com1_send_hex_daxian(Com1SndBuf, str(Com1SndBuf));
}

/******************************************************************************
 函数名称：display_slv2
 功能描述：显示显存中的数据到屏幕上，副显
 参数名称：	输入/输出？	类型		描述
 str		输入		INT8U *		要显示的字符串
 
 返  回  值：无
 
 作      者	：许岩
 日      期：2006-03-22
 修改历史：
		日期		修改人		修改描述
		------		---------	-------------
******************************************************************************/


