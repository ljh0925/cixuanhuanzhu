/******************************************************************************
Copyright 2005 大连金德姆电子有限公司
All rights riserved.

文件名	：drv_delay.c
模块名称：延时驱动程序
功能概要：延时驱动程序

取代版本：0.0.1
修改人	：许岩
完成日期：2005.04.06
升级说明：create

******************************************************************************/
#include "config.h"



/*****************************************************************
函数原型：Display_Date_And_Time
功能描述：本函数实现从时钟芯片读取世纪年月日时分,然后显示
参数描述：无
参数名称：  输入/输出？ 类型        描述
-----------     ----------- ------      -------
返  回  值：无
作      者  ：许岩

日      期  ：2003-10-14
修改历史：
日期        修改人      修改描述
------      ---------   -------------
*****************************************************************/
void Display_Date_And_Time(void)
{
	INT8U i = 0;
	BUS_TIME time;
	char buf[20];

	ToggleWD();

	i = Get_Time(&time);
	if ( i != ok )
	{
		memset((void *)&time, 0x00, sizeof(time));
	}

//  sprintf(buf, "%02BX%02BX-%02BX-%02BX %02BX:%02BX",
//  		time.century, time.year, time.month, time.day, time.hour, time.minute);
	sprintf(buf, "%02X%02X-%02X-%02X %02X:%02X", 
			time.century, time.year, time.month, time.day, time.hour, time.minute);
	lcddisp(3, 0, buf);
}


// /*********************************************************************************************************
// ** 函数名称: Task_Sound
// ** 功能描述:    语音以及蜂鸣提示任务
// ** 输　入: 无
// ** 输　出: 无
// ** 全局变量: 无
// ** 调用模块: OSInit,OSTaskCreate,OSStart
// **
// ** 作　者:黄力国
// ** 日　期: 2003年12月28日
// **-------------------------------------------------------------------------------------------------------
// ** 修改人:
// ** 日　期:
// **------------------------------------------------------------------------------------------------------
// ********************************************************************************************************/
// void delay_10ms(INT32U _10ms)
// {
//     OS_ENTER_CRITICAL();
//     _10ms=_10ms;
//     T1PR=99;
//     T1MCR=0X03;
//     T1MR0=((110592/100)*_10ms);
//     T1TCR=0X03;
//     T1TCR=0X01;
//     while((T1IR&0X01)==0)
//         ;
//     T1IR=0X01;
//     OS_EXIT_CRITICAL();
//     return;
// }

/******************************************************************************
 函数名称：SleepMs
 功能描述：延时函数，11.0592M*4晶振专用，开mem加速
 参数名称：	输入/输出？	类型		描述
 _ms	输入	INT16U				要延时的倍数 1ms*?
 
 返  回  值：无
 
 作      者	：许岩
 日      期：2004-09-02
 修改历史：
		日期		修改人		修改描述
		------		---------	-------------
******************************************************************************/
void SleepMs(INT16U _ms)
{
	INT16U i = 0;

	ToggleWD();

	for ( i=0; i<_ms; i++ )
	{
		Sleep10us(100);
	}
}

/******************************************************************************
 函数名称：SleepMs2
 功能描述：延时函数，11.0592M*4晶振专用，开mem加速
 参数名称：	输入/输出？	类型		描述
 _ms	输入	INT16U				要延时的倍数 1ms*?
 
 返  回  值：无
 
 作      者	：许岩
 日      期：2004-09-02
 修改历史：
		日期		修改人		修改描述
		------		---------	-------------
******************************************************************************/
void SleepMs2(INT16U _ms)
{
	INT16U i = 0;

	ToggleWD();

	for ( i=0; i<_ms / 100; i++ )
	{
		OSTimeDlyHMSM(0, 0, 0, 100);
	}
}

/******************************************************************************
 函数名称：Sleep10us
 功能描述：延时函数，11.0592M*4晶振专用，开mem加速
 参数名称：	输入/输出？	类型		描述
 _us	输入	INT16U				要延时的倍数 10us*?
 
 返  回  值：无
 
 作      者	：许岩
 日      期：2004-09-02
 修改历史：
		日期		修改人		修改描述
		------		---------	-------------
******************************************************************************/
void Sleep10us(INT16U _us)
{
	INT8U i = 0;
	INT16U j;

	ToggleWD();

	for ( j=0; j<_us; j++ )
	{
		for ( i=0; i<58; i++ )
			;
	}
}

/******************************************************************************
 函数名称：ascii_to_hex
 功能描述：把一个0-9的ascii代码，转化为16进制数
 参数名称： 输入/输出？ 类型        描述
 num        输入        INT8U           要转化为ascii代码的数，要求范围0-9 a-f A-F

 返  回  值：转化后的16进制数

 作      者 ：许岩
 日      期：2004-09-02
 修改历史：
		日期        修改人      修改描述
		------      ---------   -------------
******************************************************************************/
INT8U ascii_to_hex(INT8U num)
{
	ToggleWD();

// 	return (num - 0x30);
	if ( num <= '9' )
		return(num - 0x30);
	else if ( num == 'a' || num == 'A' )
		return 0x0A;
	else if ( num == 'b' || num == 'B' )
		return 0x0B;
	else if ( num == 'c' || num == 'C' )
		return 0x0C;
	else if ( num == 'd' || num == 'D' )
		return 0x0D;
	else if ( num == 'e' || num == 'E' )
		return 0x0E;
	else if ( num == '_' )
		return 0x00;
	else
		return 0x0F;
}

/*****************************************************************
函数原型：bcdhex
功能描述：bcd码转换为hex码
参数描述：
参数名称：	输入/输出？	类型		描述
-----------		-----------	------	   	-------
bcd				输入			INT8U		输入的bcd码

返  回  值：转换后的hex码
作      者	：许岩
日      期：2006-01-09
修改历史：
日期		修改人		修改描述
------		---------	-------------
*****************************************************************/
INT8U bcdhex(INT8U bcd)
{
	ToggleWD();

	return((bcd >> 4) * 10 + (bcd & 0x0F));
}

/******************************************************************************
 函数名称：ascii
 功能描述：把一个0-9的数转化为ascii代码，此函数也可扩展用于通讯中，通讯中涉及到一些A-F的非法输入，认为合法
 参数名称：	输入/输出？	类型		描述
 num		输入		INT8U			要转化为ascii代码的数，要求范围0-9
 
 返  回  值：转化后的ascii代码
 
 作      者	：许岩
 日      期：2004-09-02
 修改历史：
		日期		修改人		修改描述
		------		---------	-------------
******************************************************************************/
INT8U ascii(INT8U num)
{
	ToggleWD();

//     return (num + 0x30);
	if ( num <= 9 )
		return(num + 0x30);
	else if ( num == 0x0A )
		return 'A';
	else if ( num == 0x0B )
		return 'B';
	else if ( num == 0x0C )
		return 'C';
	else if ( num == 0x0D )
		return 'D';
	else if ( num == 0x0E )
		return 'E';
	else
//      if (num == 0x0F)
		return 'F';
}

// *****************************************************************
// 功能：在屏幕上输出字符
// 入口参数：	lb->显示输出字符
// 出口参数：	Null
// 作者：
// 函数出处：EH0218---COMMON.C例子程序
// *****************************************************************
char HextoBcd(char sour)
{
	ToggleWD();

	return(((sour/10)<<4) |(sour%10));
}

/******************************************************************************
 函数名称：delay_and_wait_key
 功能描述：等待任意键返回
 参数名称：	输入/输出？	类型		描述
 second		输入		int				要等待的秒数

 返  回  值：键值

 作      者	：许岩
 日      期：2004-09-02
 修改历史：
		日期		修改人		修改描述
		------		---------	-------------
******************************************************************************/
INT8U delay_and_wait_key( int second,long qEvent, int autoexit )
{
	INT8U key = NO_KEY;
	INT32U i = 0;

	ToggleWD();

	qEvent = qEvent;
	autoexit = autoexit;

//  key = query_key();          //清掉缓存

	key = NO_KEY;
	if ( second == 0 )
	{
		for ( ;; )
		{
			ToggleWD();
			OSTimeDlyHMSM(0, 0, 0, 10);

			key = query_key();
			if ( key == NO_KEY )
				continue;
			else
				return key;
		}
	}
	else
	{
		for ( i=0; i<(INT32U)second * 100UL; i++ )				   //直到得到一个有效按键为止
		{
			ToggleWD();
			OSTimeDlyHMSM(0, 0, 0, 10);

			key = query_key();
			if ( key == NO_KEY )
				continue;
			else
				return key;
		}
	}

	return key;
}

/******************************************************************************
 函数名称：delay_and_wait_key
 功能描述：等待任意键返回
 参数名称：	输入/输出？	类型		描述
 mili_second	输入		int				要等待的豪秒数

 返  回  值：键值

 作      者	：许岩
 日      期：2004-09-02
 修改历史：
		日期		修改人		修改描述
		------		---------	-------------
******************************************************************************/
INT8U delay_and_wait_key_ms( int mili_second,long qEvent, int autoexit )
{
	INT8U key = NO_KEY;
	INT32U i = 0;

	ToggleWD();

	qEvent = qEvent;
	autoexit = autoexit;

//  key = query_key();          //清掉缓存

	key = NO_KEY;
	if ( mili_second == 0 )
	{
		for ( ;; )
		{
			ToggleWD();
			OSTimeDlyHMSM(0, 0, 0, 10);

			key = query_key();
			if ( key == NO_KEY )
				continue;
			else
				return key;
		}
	}
	else
	{
		for ( i=0; i<(INT32U)mili_second / 10UL; i++ )				   //直到得到一个有效按键为止
		{
			ToggleWD();
			OSTimeDlyHMSM(0, 0, 0, 10);

			key = query_key();
			if ( key == NO_KEY )
				continue;
			else
				return key;
		}
	}

	return key;
}

// /******************************************************************************
//  函数名称：pick_up_quotation_str
//  功能描述： 从一个字符串中提取""中的字节
//  参数名称：	输入/输出？	类型		描述
//  input		输入		INT8U *			要提取的源字符串
//  output		输出		INT8U *			提取出的字符串
//
//  返  回  值：ok-成功
// 				notok-失败，输入格式非法
//
//  作      者	：许岩
//  日      期：2004-09-02
//  修改历史：
// 		日期		修改人		修改描述
// 		------		---------	-------------
// ******************************************************************************/
// INT8U pick_up_quotation_str(INT8U *input, INT8U* output)
// {
// 	INT16U i = 0;
// 	INT16U j = 0;
//
// 	ToggleWD();
//
// 	for(i=0; i<strlen((void *)input); i++)
// 	{
// 		if (input[i] == '"')
// 		{
// 			break;
// 		}
// 	}
// 	if (i >= strlen((void *)input))
// 	{
// 		*output = '\0';
// 		return notok;
// 	}
//
// 	j = i + 1;
// 	for(; j<strlen((void *)input); j++)
// 	{
// 		if (input[i] == '"')
// 		{
// 			*output = '\0';
// 			return ok;
// 		}
// 		*output = input[j];
// 		output++;
// 	}
//
// 	*output = '\0';
// 	return notok;
//
// }

/******************************************************************************
 函数名称：htoa
 功能描述：hex转换为ascii码
 参数描述：
 参数名称： 输入/输出？ 类型		描述

 返  回  值：ok(0)-成功
			 notok(0xFF)-失败

 作 	 者 ：许岩
 日 	 期：2005-04-07
 修改历史：
	 日期		修改人		修改描述
	 ------		---------	-------------
******************************************************************************/
void htoa(void *des, char *sour, int hex_len)
{
	 int i = 0;
	 char *dest = (char *)des;

	 if ( hex_len<=0 )
		 return;

	 for ( i=0; i<hex_len; i++ )
		 sprintf((char *)dest + i * 2, "%02x", sour[i]);

	 dest[hex_len * 2] = '\0';
}

/******************************************************************************
 函数名称：atoh
 功能描述：ascii转换为hex码
 参数描述：
 参数名称： 输入/输出？ 类型		描述
				
 返  回  值：无
				   
 作 	 者 ：许岩
 日 	 期：2005-04-07
 修改历史：
		日期		修改人		修改描述
		------		---------	-------------
******************************************************************************/
void atoh(void *des, INT8U *sour, int ascii_len)
{
	int i = 0;
	char *dest = (char *)des;

	ToggleWD();

	if ( ascii_len<=0 )
		return;

	for ( i=0; i<ascii_len; i++ )
	{
		if ( i % 2 == 0 )
			continue;

		dest[i / 2] = (ascii_to_hex(sour[i - 1]) << 4) | ascii_to_hex(sour[i]);
	}
}

/******************************************************************************
 函数名称：read_mod_reg
 功能描述：取得一个带符号的MODBUS寄存器的值
 参数名称：	输入/输出？	类型		描述
 reg			输入		INT16U *	MODBUS寄存器

 返  回  值：寄存器值

 作      者	：许岩
 日      期：2004-09-02
 修改历史：
	   日期		修改人		修改描述
	   ------		---------	-------------
******************************************************************************/
INT32S read_mod_reg(INT16U *reg)
{
	INT16U reg2 = 0;
//  INT32S temp_int32s = 0;

	ToggleWD();

	OS_ENTER_CRITICAL();
	reg2 = *reg;
	OS_EXIT_CRITICAL();
	if ( (reg2 & 0x8000) == 0 )
	{
		return (INT32S)reg2;
	}
	else
	{
		return (0 - (INT32S)(reg2 & (~0x8000)));
	}
}

/******************************************************************************
 函数名称：write_mod_reg
 功能描述：将一个带符号数写入MODBUS寄存器
 参数名称：	输入/输出？	类型		描述
 reg		输出		INT16U *	MODBUS寄存器
 num		输入		INT32S		要写入的值

 返  回  值：无

 作      者	：许岩
 日      期：2004-09-02
 修改历史：
	   日期		修改人		修改描述
	   ------		---------	-------------
******************************************************************************/
void write_mod_reg(INT16U *reg, INT32S num)
{
	ToggleWD();

	OS_ENTER_CRITICAL();
	if (num < 0)
	{
		*reg = (INT16U)abs(num);
		*reg |= 0x8000;		//最高位置1
	}
	else
		*reg = (INT16U)num;
	OS_EXIT_CRITICAL();
}

